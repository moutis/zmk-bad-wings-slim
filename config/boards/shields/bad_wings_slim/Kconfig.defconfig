## config/boards/shields/bad_wings_slim/Kconfig.defconfig
```kconfig
# Copyright (c) 2022 The ZMK Contributors
# SPDX-License-Identifier: MIT

if SHIELD_BAD_WINGS_SLIM

config ZMK_KEYBOARD_NAME
    default "Wafer HD-Vibranium"
endif
```
