/*
 * Copyright (c) 2022 The ZMK Contributors
 *
 * SPDX-License-Identifier: MIT
 */

#include <behaviors.dtsi>
#include <dt-bindings/zmk/keys.h>
#include <dt-bindings/zmk/bt.h>
#include <dt-bindings/zmk/outputs.h>


#include "bad_wings_slim_config.dtsi" // key name defs for this board
#include "moutis_config.dtsi" // my add-on feature defs

/ {
#include "moutis_behaviors.dtsi"
#include "moutis_macros.dtsi"
#include "moutis_combos-vb.dtsi"

    keymap {
        compatible = "zmk,keymap";
#include "bad_wings_slim.l_alpha-HD-vb.dtsi"  // base (alpha) layer (& related adaptive layers)
#include "bad_wings_slim.l_layers.dtsi"  // all other (common) layers (shouldn't vary)

    };
};
